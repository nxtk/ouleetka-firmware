## boards/shields/ouleetka/Kconfig.defconfig
```kconfig
if SHIELD_OULEETKA_RIGHT

config ZMK_SPLIT_ROLE_CENTRAL
    default y

config ZMK_SPLIT_BLE_CENTRAL_BATTERY_LEVEL_FETCHING
    default y

config ZMK_SPLIT_BLE_CENTRAL_BATTERY_LEVEL_PROXY
    default y

config ZMK_SPLIT_PERIPHERAL_HID_INDICATORS
    default y
endif

if SHIELD_OULEETKA

config ZMK_KEYBOARD_NAME
    default "Ouleetka"

config ZMK_SPLIT
    default y

if ZMK_DISPLAY

config I2C
    default y

config SSD1306
    default y

if LVGL

config LV_Z_VDB_SIZE
    default 64

config LV_DPI_DEF
    default 148

config LV_Z_BITS_PER_PIXEL
    default 1

choice LV_COLOR_DEPTH
    default LV_COLOR_DEPTH_1
endchoice

endif # LVGL

endif # ZMK_DISPLAY

endif # SHIELD_OULEETKA
```

## boards/shields/ouleetka/Kconfig.shield
```kconfig
config SHIELD_OULEETKA
    bool

config SHIELD_OULEETKA_RIGHT
    def_bool $(shields_list_contains,ouleetka_right)
    select SHIELD_OULEETKA

config SHIELD_OULEETKA_LEFT
    def_bool $(shields_list_contains,ouleetka_left)
    select SHIELD_OULEETKA
    
```
